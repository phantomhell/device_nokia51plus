/*
 * Copyright (C) 2010 - 2017 Novatek, Inc.
 *
 * $Revision: 19589 $
 * $Date: 2017-11-28 21:26:00 +0800 (?变?, 28 ?佷???2017) $
 *
 * This program is free software; you can redistribute it and/or modify
 * it under the terms of the GNU General Public License as published by
 * the Free Software Foundation; either version 2 of the License, or
 * (at your option) any later version.
 *
 * This program is distributed in the hope that it will be useful, but WITHOUT
 * ANY WARRANTY; without even the implied warranty of MERCHANTABILITY or
 * FITNESS FOR A PARTICULAR PURPOSE.  See the GNU General Public License for
 * more details.
 *
 */

&i2c0 {

	/* Novatek device tree node */
	cap_touch@62 {
		compatible = "mediatek,cap_touch";	//Use MTK default touch
		reg = <0x62>;
		status = "ok";

		/* MP */
		novatek,mp-support-dt;

		novatek-mp-criteria-5105@0 {
			#address-cells = <1>;
			#size-cells = <0>;
			compatible = "novatek-mp-criteria-5105";//5106 is pid of Truly586	;5105 is pid of TM586

			/* MP Config */
			IC_X_CFG_SIZE = <18>;
			IC_Y_CFG_SIZE = <32>;
			IC_KEY_CFG_SIZE = <4>;
			X_Channel = <18>;
			Y_Channel = <32>;
			AIN_X = <0 1 2 3 4 5 6 7 8 9 10 11 12 13 14 15 16 17>;
			AIN_Y = <0 1 2 3 4 5 6 7 8 9 10 11 12 13 14 15 16 17 18 19 20 21 22 23 24 25 26 27 28 29 30 31>;
			AIN_KEY = <0 1 2 0xFF>;

			/* MP Criteria */
			PS_Config_Lmt_Short_Rawdata_P = <
				14008 14008 14008 14008 14008 14008 14008 14008 14008 14008 14008 14008 14008 14008 14008 14008 14008 14008
				14008 14008 14008 14008 14008 14008 14008 14008 14008 14008 14008 14008 14008 14008 14008 14008 14008 14008
				14008 14008 14008 14008 14008 14008 14008 14008 14008 14008 14008 14008 14008 14008 14008 14008 14008 14008
				14008 14008 14008 14008 14008 14008 14008 14008 14008 14008 14008 14008 14008 14008 14008 14008 14008 14008
				14008 14008 14008 14008 14008 14008 14008 14008 14008 14008 14008 14008 14008 14008 14008 14008 14008 14008
				14008 14008 14008 14008 14008 14008 14008 14008 14008 14008 14008 14008 14008 14008 14008 14008 14008 14008
				14008 14008 14008 14008 14008 14008 14008 14008 14008 14008 14008 14008 14008 14008 14008 14008 14008 14008
				14008 14008 14008 14008 14008 14008 14008 14008 14008 14008 14008 14008 14008 14008 14008 14008 14008 14008
				14008 14008 14008 14008 14008 14008 14008 14008 14008 14008 14008 14008 14008 14008 14008 14008 14008 14008
				14008 14008 14008 14008 14008 14008 14008 14008 14008 14008 14008 14008 14008 14008 14008 14008 14008 14008
				14008 14008 14008 14008 14008 14008 14008 14008 14008 14008 14008 14008 14008 14008 14008 14008 14008 14008
				14008 14008 14008 14008 14008 14008 14008 14008 14008 14008 14008 14008 14008 14008 14008 14008 14008 14008
				14008 14008 14008 14008 14008 14008 14008 14008 14008 14008 14008 14008 14008 14008 14008 14008 14008 14008
				14008 14008 14008 14008 14008 14008 14008 14008 14008 14008 14008 14008 14008 14008 14008 14008 14008 14008
				14008 14008 14008 14008 14008 14008 14008 14008 14008 14008 14008 14008 14008 14008 14008 14008 14008 14008
				14008 14008 14008 14008 14008 14008 14008 14008 14008 14008 14008 14008 14008 14008 14008 14008 14008 14008
				14008 14008 14008 14008 14008 14008 14008 14008 14008 14008 14008 14008 14008 14008 14008 14008 14008 14008
				14008 14008 14008 14008 14008 14008 14008 14008 14008 14008 14008 14008 14008 14008 14008 14008 14008 14008
				14008 14008 14008 14008 14008 14008 14008 14008 14008 14008 14008 14008 14008 14008 14008 14008 14008 14008
				14008 14008 14008 14008 14008 14008 14008 14008 14008 14008 14008 14008 14008 14008 14008 14008 14008 14008
				14008 14008 14008 14008 14008 14008 14008 14008 14008 14008 14008 14008 14008 14008 14008 14008 14008 14008
				14008 14008 14008 14008 14008 14008 14008 14008 14008 14008 14008 14008 14008 14008 14008 14008 14008 14008
				14008 14008 14008 14008 14008 14008 14008 14008 14008 14008 14008 14008 14008 14008 14008 14008 14008 14008
				14008 14008 14008 14008 14008 14008 14008 14008 14008 14008 14008 14008 14008 14008 14008 14008 14008 14008
				14008 14008 14008 14008 14008 14008 14008 14008 14008 14008 14008 14008 14008 14008 14008 14008 14008 14008
				14008 14008 14008 14008 14008 14008 14008 14008 14008 14008 14008 14008 14008 14008 14008 14008 14008 14008
				14008 14008 14008 14008 14008 14008 14008 14008 14008 14008 14008 14008 14008 14008 14008 14008 14008 14008
				14008 14008 14008 14008 14008 14008 14008 14008 14008 14008 14008 14008 14008 14008 14008 14008 14008 14008
				14008 14008 14008 14008 14008 14008 14008 14008 14008 14008 14008 14008 14008 14008 14008 14008 14008 14008
				14008 14008 14008 14008 14008 14008 14008 14008 14008 14008 14008 14008 14008 14008 14008 14008 14008 14008
				14008 14008 14008 14008 14008 14008 14008 14008 14008 14008 14008 14008 14008 14008 14008 14008 14008 14008
				14008 14008 14008 14008 14008 14008 14008 14008 14008 14008 14008 14008 14008 14008 14008 14008 14008 14008
				>;

			PS_Config_Lmt_Short_Rawdata_N = <
				11376 11376 11376 11376 11376 11376 11376 11376 11376 11376 11376 11376 11376 11376 11376 11376 11376 11376
				11376 11376 11376 11376 11376 11376 11376 11376 11376 11376 11376 11376 11376 11376 11376 11376 11376 11376
				11376 11376 11376 11376 11376 11376 11376 11376 11376 11376 11376 11376 11376 11376 11376 11376 11376 11376
				11376 11376 11376 11376 11376 11376 11376 11376 11376 11376 11376 11376 11376 11376 11376 11376 11376 11376
				11376 11376 11376 11376 11376 11376 11376 11376 11376 11376 11376 11376 11376 11376 11376 11376 11376 11376
				11376 11376 11376 11376 11376 11376 11376 11376 11376 11376 11376 11376 11376 11376 11376 11376 11376 11376
				11376 11376 11376 11376 11376 11376 11376 11376 11376 11376 11376 11376 11376 11376 11376 11376 11376 11376
				11376 11376 11376 11376 11376 11376 11376 11376 11376 11376 11376 11376 11376 11376 11376 11376 11376 11376
				11376 11376 11376 11376 11376 11376 11376 11376 11376 11376 11376 11376 11376 11376 11376 11376 11376 11376
				11376 11376 11376 11376 11376 11376 11376 11376 11376 11376 11376 11376 11376 11376 11376 11376 11376 11376
				11376 11376 11376 11376 11376 11376 11376 11376 11376 11376 11376 11376 11376 11376 11376 11376 11376 11376
				11376 11376 11376 11376 11376 11376 11376 11376 11376 11376 11376 11376 11376 11376 11376 11376 11376 11376
				11376 11376 11376 11376 11376 11376 11376 11376 11376 11376 11376 11376 11376 11376 11376 11376 11376 11376
				11376 11376 11376 11376 11376 11376 11376 11376 11376 11376 11376 11376 11376 11376 11376 11376 11376 11376
				11376 11376 11376 11376 11376 11376 11376 11376 11376 11376 11376 11376 11376 11376 11376 11376 11376 11376
				11376 11376 11376 11376 11376 11376 11376 11376 11376 11376 11376 11376 11376 11376 11376 11376 11376 11376
				11376 11376 11376 11376 11376 11376 11376 11376 11376 11376 11376 11376 11376 11376 11376 11376 11376 11376
				11376 11376 11376 11376 11376 11376 11376 11376 11376 11376 11376 11376 11376 11376 11376 11376 11376 11376
				11376 11376 11376 11376 11376 11376 11376 11376 11376 11376 11376 11376 11376 11376 11376 11376 11376 11376
				11376 11376 11376 11376 11376 11376 11376 11376 11376 11376 11376 11376 11376 11376 11376 11376 11376 11376
				11376 11376 11376 11376 11376 11376 11376 11376 11376 11376 11376 11376 11376 11376 11376 11376 11376 11376
				11376 11376 11376 11376 11376 11376 11376 11376 11376 11376 11376 11376 11376 11376 11376 11376 11376 11376
				11376 11376 11376 11376 11376 11376 11376 11376 11376 11376 11376 11376 11376 11376 11376 11376 11376 11376
				11376 11376 11376 11376 11376 11376 11376 11376 11376 11376 11376 11376 11376 11376 11376 11376 11376 11376
				11376 11376 11376 11376 11376 11376 11376 11376 11376 11376 11376 11376 11376 11376 11376 11376 11376 11376
				11376 11376 11376 11376 11376 11376 11376 11376 11376 11376 11376 11376 11376 11376 11376 11376 11376 11376
				11376 11376 11376 11376 11376 11376 11376 11376 11376 11376 11376 11376 11376 11376 11376 11376 11376 11376
				11376 11376 11376 11376 11376 11376 11376 11376 11376 11376 11376 11376 11376 11376 11376 11376 11376 11376
				11376 11376 11376 11376 11376 11376 11376 11376 11376 11376 11376 11376 11376 11376 11376 11376 11376 11376
				11376 11376 11376 11376 11376 11376 11376 11376 11376 11376 11376 11376 11376 11376 11376 11376 11376 11376
				11376 11376 11376 11376 11376 11376 11376 11376 11376 11376 11376 11376 11376 11376 11376 11376 11376 11376
				11376 11376 11376 11376 11376 11376 11376 11376 11376 11376 11376 11376 11376 11376 11376 11376 11376 11376
				>;

			
			PS_Config_Lmt_Open_Rawdata_P = <
                2703 2794 2822 2774 65535 65535 65535 65535 65535 65535 65535 65535 65535 65535 2727 2801 2778 2657
                1958 1998 2015 1998 2026 1751 1746 1749 1786 1787 1726 1734 1736 2017 1982 2009 1978 2028
                1921 1949 1956 1941 1993 1956 1969 1963 2007 2002 1929 1944 1925 1957 1917 1941 1918 1975
                1894 1931 1941 1920 1972 1917 1934 1799 1846 1986 1915 1920 1912 1946 1913 1924 1780 1819
                1852 1893 1903 1883 1934 1880 1894 1887 1934 1950 1881 1885 1884 1913 1880 1890 1873 1908
                1892 1933 1944 1924 1975 1917 1932 1930 1978 1986 1918 1922 1921 1950 1915 1924 1914 1949
                1853 1894 1904 1885 1935 1752 1766 1892 1939 1946 1879 1883 1882 1911 1749 1760 1876 1911
                1856 1899 1908 1889 1938 1883 1896 1896 1943 1949 1881 1885 1883 1912 1878 1888 1879 1913
                1858 1902 1910 1889 1937 1889 1902 1899 1945 1949 1881 1885 1879 1909 1882 1892 1880 1913
                1860 1904 1912 1764 1810 1891 1904 1901 1947 1955 1886 1890 1758 1787 1888 1898 1885 1918
                1862 1906 1914 1886 1940 1894 1905 1904 1948 1955 1885 1890 1886 1915 1880 1898 1886 1918
                1871 1903 1917 1892 1946 1903 1913 1913 1956 1956 1883 1888 1889 1918 1876 1900 1880 1920
                1867 1769 1777 1890 1942 1900 1908 1911 1952 1957 1757 1762 1890 1917 1876 1893 1876 1920
                1865 1897 1900 1889 1940 1899 1908 1909 1951 1960 1888 1892 1894 1920 1880 1892 1880 1924
                1864 1903 1907 1893 1944 1903 1911 1913 1955 1957 1892 1896 1895 1921 1881 1893 1881 1925
                1734 1906 1909 1895 1947 1908 1914 1915 1957 1828 1895 1900 1893 1927 1884 1896 1884 1929
                1872 1909 1912 1898 1949 1909 1917 1918 1960 1961 1895 1900 1891 1921 1884 1897 1884 1929
                1874 1907 1911 1897 1948 1907 1916 1916 1959 1973 1903 1907 1900 1928 1892 1905 1892 1935
                1875 1909 1913 1898 1949 1909 1917 1917 1959 1966 1896 1901 1893 1921 1885 1898 1884 1928
                1873 1907 1910 1897 1949 1908 1916 1918 1960 1968 1897 1903 1895 1922 1887 1901 1889 1933
                1879 1914 1918 1903 1963 1912 1920 1925 1968 1968 1898 1904 1895 1923 1884 1898 1890 1933
                1874 1908 1912 1898 1948 1909 1918 1920 1962 1969 1899 1904 1896 1923 1888 1902 1891 1935
                1873 1907 1911 1897 1942 1909 1918 1919 1962 1969 1898 1904 1895 1921 1888 1902 1890 1935
                1873 1907 1911 1894 1939 1909 1918 1919 1962 1968 1898 1903 1891 1918 1886 1901 1890 1934
                1876 1910 1914 1900 1951 1912 1922 1922 1965 1971 1900 1906 1896 1923 1888 1903 1892 1936
                1876 1910 1913 1900 1953 1912 1922 1922 1965 1973 1903 1908 1899 1925 1891 1906 1894 1938
                1877 1908 1912 1901 1948 1914 1923 1924 1967 1973 1900 1906 1900 1926 1892 1907 1895 1940
                1879 1913 1917 1904 1950 1916 1926 1927 1970 1979 1907 1916 1904 1929 1897 1914 1899 1946
                1880 1915 1920 1906 1953 1918 1928 1929 1973 1974 1903 1913 1899 1932 1892 1911 1895 1942
                1909 1945 1952 1935 1992 1948 1961 1959 2006 2007 1936 1949 1933 1969 1925 1948 1928 1982
                2014 2024 2031 2009 2066 2023 2040 2035 2087 2089 2008 2026 2004 2045 1995 2024 2004 2086
                1580 2136 2130 2110 2161 2124 2137 2146 2207 2206 2116 2123 2102 2132 2093 2123 2111 1578
				>;

			PS_Config_Lmt_Open_Rawdata_N = <
				1455 1504 1519 1494 (-65535) (-65535) (-65535) (-65535) (-65535) (-65535) (-65535) (-65535) (-65535) (-65535) 1468 1508 1496 1431
                1054 1076 1085 1076 1091  943  940  942  962  962  929  934  935  1086 1067 1082 1065 1092
                1034 1050 1053 1045 1073 1053 1060 1057 1081 1078 1039 1047 1037 1054 1032 1045 1033 1064
                1020 1040 1045 1034 1062 1032 1041 969  994  1069 1031 1034 1030 1048 1030 1036 959  979
                997  1020 1025 1014 1041 1012 1020 1016 1041 1050 1013 1015 1014 1030 1013 1018 1009 1028
                1019 1041 1047 1036 1063 1032 1040 1039 1065 1069 1033 1035 1034 1050 1031 1036 1031 1050
                998  1020 1025 1015 1042 943  951  1019 1044 1048 1012 1014 1013 1029 942  948  1010 1029
                1000 1022 1027 1017 1044 1014 1021 1021 1046 1050 1013 1015 1014 1030 1011 1017 1012 1030
                1001 1024 1029 1017 1043 1017 1024 1023 1047 1050 1013 1015 1012 1028 1013 1019 1012 1030
                1002 1025 1030 950  975  1018 1025 1024 1048 1053 1015 1018 947  962  1016 1022 1015 1033
                1003 1026 1030 1015 1044 1020 1026 1025 1049 1052 1015 1018 1015 1031 1012 1022 1015 1033
                1007 1025 1032 1019 1048 1025 1030 1030 1053 1053 1014 1016 1017 1033 1010 1023 1012 1034
                1006 953  957  1018 1045 1023 1028 1029 1051 1054  946  949 1018 1032 1010 1019 1010 1034
                1004 1021 1023 1017 1044 1023 1027 1028 1051 1055 1017 1019 1020 1034 1012 1019 1012 1036
                1004 1025 1027 1019 1047 1025 1029 1030 1053 1054 1019 1021 1020 1034 1013 1019 1013 1037
                934  1026 1028 1021 1048 1028 1030 1031 1054 984  1020 1023 1020 1037 1015 1021 1015 1039
                1008 1028 1030 1022 1050 1028 1032 1033 1055 1056 1020 1023 1018 1034 1014 1021 1015 1038
                1009 1027 1029 1022 1049 1027 1032 1032 1055 1062 1025 1027 1023 1038 1019 1026 1019 1042
                1010 1028 1030 1022 1050 1028 1032 1032 1055 1059 1021 1023 1019 1034 1015 1022 1014 1038
                1008 1027 1029 1021 1050 1027 1032 1033 1056 1060 1022 1024 1020 1035 1016 1024 1017 1041
                1012 1030 1033 1025 1057 1029 1034 1037 1060 1060 1022 1025 1021 1036 1015 1022 1018 1041
                1009 1027 1030 1022 1049 1028 1033 1034 1057 1060 1023 1025 1021 1036 1017 1024 1018 1042
                1009 1027 1029 1021 1046 1028 1033 1033 1056 1060 1022 1025 1020 1034 1016 1024 1018 1042
                1009 1027 1029 1020 1044 1028 1033 1033 1057 1060 1022 1025 1018 1033 1016 1024 1018 1041
                1010 1029 1031 1023 1050 1030 1035 1035 1058 1061 1023 1026 1021 1035 1017 1025 1019 1043
                1010 1028 1030 1023 1052 1030 1035 1035 1058 1062 1024 1028 1023 1036 1018 1026 1020 1044
                1010 1027 1029 1024 1049 1030 1036 1036 1059 1063 1023 1026 1023 1037 1019 1027 1021 1045
                1012 1030 1032 1025 1050 1032 1037 1038 1061 1066 1027 1032 1025 1039 1021 1031 1023 1048
                1012 1031 1034 1026 1051 1033 1038 1039 1062 1063 1024 1030 1022 1040 1019 1029 1020 1046
                1028 1047 1051 1042 1072 1049 1056 1055 1080 1081 1042 1050 1041 1060 1036 1049 1038 1067
                1085 1090 1094 1082 1112 1089 1098 1096 1124 1125 1081 1091 1079 1101 1074 1090 1079 1123
                851  1150 1147 1136 1164 1144 1151 1155 1188 1188 1139 1143 1132 1148 1127 1143 1137 850
				>;

			PS_Config_Lmt_FW_Rawdata_P = <
				821	816	825	824 65535 65535 65535 65535 65535 65535 65535 65535 65535 65535 843	827	835	839
                823	806	830	812	829	834	830	833	828	834	849	837	850	835	830	832	827	842
                827	816	833	825	832	827	832	822	831	836	841	837	841	835	839	836	834	847
                828	820	835	829	833	827	831	826	830	837	843	838	843	836	845	835	836	846
                827	821	833	831	831	830	831	827	831	837	847	838	846	836	845	835	836	842
                827	819	832	828	832	831	832	829	832	834	847	838	848	837	847	836	838	844
                827	819	833	825	832	830	832	829	833	834	846	837	847	836	844	838	836	844
                825	819	834	829	833	831	833	826	831	836	845	838	845	836	845	837	835	845
                829	821	834	829	832	828	830	827	832	837	842	838	847	839	843	836	838	846
                828	819	832	828	831	829	833	827	831	837	845	836	846	837	846	836	838	845
                827	820	832	827	833	829	832	829	833	835	846	836	847	837	843	835	839	846
                827	822	833	827	834	830	833	828	832	839	845	838	848	837	843	836	838	846
                830	823	833	828	832	831	834	826	830	836	845	838	848	837	843	835	837	845
                827	821	832	829	832	828	830	828	833	837	847	836	846	835	843	837	840	845
                828	821	832	828	831	830	832	826	831	836	844	836	848	836	844	837	840	846
                829	820	834	828	833	829	831	829	832	839	845	836	847	837	846	839	839	849
                830	823	835	829	833	830	831	827	829	839	846	836	848	838	843	837	839	847
                828	823	835	829	830	829	831	827	830	836	847	835	848	838	846	835	842	849
                828	820	833	828	834	830	832	827	831	839	847	837	849	836	848	838	840	851
                829	821	833	828	836	833	835	825	830	837	850	839	848	840	846	838	843	849
                829	822	835	828	831	829	832	829	831	837	847	839	849	837	847	836	842	851
                830	821	832	828	833	830	831	830	833	836	848	838	850	837	847	840	844	853
                831	823	832	828	833	831	834	827	833	837	847	838	849	841	845	837	842	851
                829	825	837	831	833	831	834	828	831	837	848	839	850	839	847	840	843	852
                829	823	834	829	834	830	833	830	833	839	848	840	850	839	846	838	842	853
                828	825	835	831	833	830	832	831	833	839	847	837	851	840	848	838	844	853
                826	824	834	830	834	834	834	829	835	839	849	840	850	842	849	839	844	851
                830	826	834	834	834	834	834	831	834	839	852	840	854	840	850	840	846	853
                828	824	834	832	834	834	834	829	831	838	849	840	853	840	848	840	845	853
                827	820	834	830	836	831	834	830	834	839	848	840	850	841	846	840	842	850
                829	816	835	825	834	826	832	826	834	839	846	841	847	839	842	840	839	853
                833	827	833	832	834	835	832	833	832	841	853	840	853	840	847	841	848	849
				>;

			PS_Config_Lmt_FW_Rawdata_N = <
				352	350	354	353 (-65535) (-65535) (-65535) (-65535) (-65535) (-65535) (-65535) (-65535) (-65535) (-65535) 361 355 358 360
                353	345	356	348	355	357	356	357	355	357	364	359	364	358	356	357	354	361
                354	350	357	354	357	354	357	352	356	358	360	359	360	358	360	358	358	363
                355	352	358	355	357	354	356	354	356	359	361	359	361	358	362	358	358	363
                354	352	357	356	356	356	356	354	356	359	363	359	362	358	362	358	358	361
                354	351	357	355	357	356	357	355	356	358	363	359	364	359	363	358	359	362
                354	351	357	354	357	356	357	355	357	358	362	359	363	358	362	359	358	362
                354	351	357	355	357	356	357	354	356	358	362	359	362	358	362	359	358	362
                355	352	358	355	356	355	356	355	357	359	361	359	363	359	361	358	359	363
                355	351	357	355	356	355	357	354	356	359	362	358	363	359	362	358	359	362
                354	352	357	355	357	355	357	355	357	358	363	358	363	359	361	358	359	362
                354	352	357	354	357	356	357	355	357	359	362	359	364	359	361	358	359	362
                356	353	357	355	356	356	357	354	356	358	362	359	363	359	361	358	359	362
                354	352	357	355	357	355	356	355	357	359	363	358	363	358	361	359	360	362
                355	352	357	355	356	356	357	354	356	358	362	358	363	358	362	359	360	362
                355	351	357	355	357	355	356	355	356	359	362	358	363	359	362	360	360	364
                356	353	358	355	357	356	356	354	355	360	363	358	364	359	361	359	359	363
                355	353	358	355	356	355	356	355	356	358	363	358	363	359	362	358	361	364
                355	352	357	355	357	356	356	354	356	359	363	359	364	358	363	359	360	365
                355	352	357	355	358	357	358	354	356	359	364	360	363	360	363	359	361	364
                355	352	358	355	356	355	357	355	356	359	363	360	364	359	363	358	361	365
                356	352	357	355	357	356	356	356	357	358	363	359	364	359	363	360	362	366
                356	353	357	355	357	356	357	354	357	359	363	359	364	360	362	359	361	365
                355	353	359	356	357	356	357	355	356	359	364	360	364	360	363	360	361	365
                355	353	357	355	357	356	357	356	357	359	363	360	364	359	363	359	361	365
                355	354	358	356	357	356	357	356	357	360	363	359	365	360	363	359	362	366
                354	353	357	356	357	357	358	355	358	359	364	360	364	361	364	360	362	365
                356	354	358	357	357	357	357	356	357	360	365	360	366	360	364	360	362	366
                355	353	357	357	357	358	357	355	356	359	364	360	365	360	364	360	362	366
                354	351	357	356	358	356	358	356	357	359	363	360	364	360	362	360	361	364
                355	350	358	354	357	354	357	354	357	360	363	360	363	360	361	360	360	366
                357	355	357	357	358	358	357	357	357	360	366	360	366	360	363	361	364	364

				>;

			PS_Config_Lmt_FW_CC_P = <
				148	176	186	180	512	512	512	512	512	512	512	512	512	512	181	188	179	151
                137	134	134	134	135	133	134	134	137	140	137	137	136	138	137	137	137	141
                137	133	133	134	134	134	134	134	137	138	136	135	135	135	135	135	135	139
                138	134	134	134	134	134	134	135	137	138	135	135	135	135	134	133	133	136
                139	135	135	135	135	135	135	136	138	140	137	137	136	137	135	135	134	138
                137	134	134	134	134	134	134	135	137	139	136	136	136	136	135	134	134	138
                139	135	135	135	136	136	136	136	139	141	138	138	137	138	136	136	136	139
                139	136	136	136	136	136	136	137	139	141	138	138	137	138	136	136	136	140
                140	136	136	136	137	137	137	137	140	141	138	138	138	138	136	136	136	140
                140	136	136	136	137	136	137	137	140	143	139	139	139	139	138	138	137	141
                140	136	136	136	137	137	137	137	140	142	139	139	139	139	138	138	137	141
                141	137	137	137	138	137	138	138	141	142	139	139	138	139	138	137	137	141
                141	137	137	137	138	137	137	138	140	142	139	139	138	139	138	138	137	141
                141	137	137	137	137	137	137	138	140	143	140	140	140	140	139	139	139	143
                141	137	137	137	138	138	138	138	141	143	140	140	139	140	139	139	138	143
                142	138	138	138	138	138	138	139	141	143	140	140	140	140	139	139	139	143
                142	138	138	138	138	138	138	139	142	144	141	140	140	140	139	139	139	143
                141	137	137	137	138	138	138	138	141	145	142	142	141	141	140	140	140	145
                142	138	138	138	138	138	138	139	141	144	141	141	141	141	140	140	140	144
                142	138	139	139	139	139	139	139	142	145	142	141	141	141	140	140	140	145
                144	139	139	139	140	140	140	140	143	145	141	141	141	141	140	140	140	145
                142	138	138	138	138	138	138	139	142	145	142	142	141	142	141	141	141	145
                142	138	138	138	139	139	139	139	142	145	142	142	142	142	141	141	141	146
                143	138	138	138	139	139	139	139	142	145	142	142	141	141	140	140	140	145
                143	138	139	139	139	139	139	140	142	145	142	142	141	141	140	140	140	145
                142	138	138	138	139	139	139	139	142	146	142	142	142	142	141	141	141	146
                143	138	138	139	139	139	139	140	142	145	142	142	142	142	141	141	141	146
                144	139	139	139	139	139	140	140	142	145	142	142	142	142	141	141	141	146
                143	139	139	139	139	139	139	140	142	146	142	142	142	142	141	141	141	146
                144	139	139	139	139	139	139	140	142	147	144	143	143	143	142	143	142	148
                146	140	140	140	140	140	140	141	144	148	144	144	144	144	143	143	143	149
                139	144	142	141	142	142	142	142	146	149	145	145	145	145	144	145	147	141
				>;

			PS_Config_Lmt_FW_CC_N = <
				80	80	80	80	0	0	0	0	0	0	0	0	0	0	80	80	80	80
                80	80	80	80	80	80	80	80	80	80	80	80	80	80	80	80	80	80
                80	80	80	80	80	80	80	80	80	80	80	80	80	80	80	80	80	80
                80	80	80	80	80	80	80	80	80	80	80	80	80	80	80	80	80	80
                80	80	80	80	80	80	80	80	80	80	80	80	80	80	80	80	80	80
                80	80	80	80	80	80	80	80	80	80	80	80	80	80	80	80	80	80
                80	80	80	80	80	80	80	80	80	80	80	80	80	80	80	80	80	80
                80	80	80	80	80	80	80	80	80	80	80	80	80	80	80	80	80	80
                80	80	80	80	80	80	80	80	80	80	80	80	80	80	80	80	80	80
                80	80	80	80	80	80	80	80	80	80	80	80	80	80	80	80	80	80
                80	80	80	80	80	80	80	80	80	80	80	80	80	80	80	80	80	80
                80	80	80	80	80	80	80	80	80	80	80	80	80	80	80	80	80	80
                80	80	80	80	80	80	80	80	80	80	80	80	80	80	80	80	80	80
                80	80	80	80	80	80	80	80	80	80	80	80	80	80	80	80	80	80
                80	80	80	80	80	80	80	80	80	80	80	80	80	80	80	80	80	80
                80	80	80	80	80	80	80	80	80	80	80	80	80	80	80	80	80	80
                80	80	80	80	80	80	80	80	80	80	80	80	80	80	80	80	80	80
                80	80	80	80	80	80	80	80	80	80	80	80	80	80	80	80	80	80
                80	80	80	80	80	80	80	80	80	80	80	80	80	80	80	80	80	80
                80	80	80	80	80	80	80	80	80	80	80	80	80	80	80	80	80	80
                80	80	80	80	80	80	80	80	80	80	80	80	80	80	80	80	80	80
                80	80	80	80	80	80	80	80	80	80	80	80	80	80	80	80	80	80
                80	80	80	80	80	80	80	80	80	80	80	80	80	80	80	80	80	80
                80	80	80	80	80	80	80	80	80	80	80	80	80	80	80	80	80	80
                80	80	80	80	80	80	80	80	80	80	80	80	80	80	80	80	80	80
                80	80	80	80	80	80	80	80	80	80	80	80	80	80	80	80	80	80
                80	80	80	80	80	80	80	80	80	80	80	80	80	80	80	80	80	80
                80	80	80	80	80	80	80	80	80	80	80	80	80	80	80	80	80	80
                80	80	80	80	80	80	80	80	80	80	80	80	80	80	80	80	80	80
                80	80	80	80	80	80	80	80	80	80	80	80	80	80	80	80	80	80
                80	80	80	80	80	80	80	80	80	80	80	80	80	80	80	80	80	80
                80	80	80	80	80	80	80	80	80	80	80	80	80	80	80	80	80	80
				>;

			PS_Config_Lmt_FW_Diff_P = <
				35 35 35 35 65535 65535 65535 65535 65535 65535 65535 65535 65535 65535 35 35 35 35
				35 35 35 35 35 35 35 35 35 35 35 35 35 35 35 35 35 35
				35 35 35 35 35 35 35 35 35 35 35 35 35 35 35 35 35 35
				35 35 35 35 35 35 35 35 35 35 35 35 35 35 35 35 35 35
				35 35 35 35 35 35 35 35 35 35 35 35 35 35 35 35 35 35
				35 35 35 35 35 35 35 35 35 35 35 35 35 35 35 35 35 35
				35 35 35 35 35 35 35 35 35 35 35 35 35 35 35 35 35 35
				35 35 35 35 35 35 35 35 35 35 35 35 35 35 35 35 35 35
				35 35 35 35 35 35 35 35 35 35 35 35 35 35 35 35 35 35
				35 35 35 35 35 35 35 35 35 35 35 35 35 35 35 35 35 35
				35 35 35 35 35 35 35 35 35 35 35 35 35 35 35 35 35 35
				35 35 35 35 35 35 35 35 35 35 35 35 35 35 35 35 35 35
				35 35 35 35 35 35 35 35 35 35 35 35 35 35 35 35 35 35
				35 35 35 35 35 35 35 35 35 35 35 35 35 35 35 35 35 35
				35 35 35 35 35 35 35 35 35 35 35 35 35 35 35 35 35 35
				35 35 35 35 35 35 35 35 35 35 35 35 35 35 35 35 35 35
				35 35 35 35 35 35 35 35 35 35 35 35 35 35 35 35 35 35
				35 35 35 35 35 35 35 35 35 35 35 35 35 35 35 35 35 35
				35 35 35 35 35 35 35 35 35 35 35 35 35 35 35 35 35 35
				35 35 35 35 35 35 35 35 35 35 35 35 35 35 35 35 35 35
				35 35 35 35 35 35 35 35 35 35 35 35 35 35 35 35 35 35
				35 35 35 35 35 35 35 35 35 35 35 35 35 35 35 35 35 35
				35 35 35 35 35 35 35 35 35 35 35 35 35 35 35 35 35 35
				35 35 35 35 35 35 35 35 35 35 35 35 35 35 35 35 35 35
				35 35 35 35 35 35 35 35 35 35 35 35 35 35 35 35 35 35
				35 35 35 35 35 35 35 35 35 35 35 35 35 35 35 35 35 35
				35 35 35 35 35 35 35 35 35 35 35 35 35 35 35 35 35 35
				35 35 35 35 35 35 35 35 35 35 35 35 35 35 35 35 35 35
				35 35 35 35 35 35 35 35 35 35 35 35 35 35 35 35 35 35
				35 35 35 35 35 35 35 35 35 35 35 35 35 35 35 35 35 35
				35 35 35 35 35 35 35 35 35 35 35 35 35 35 35 35 35 35
				35 35 35 35 35 35 35 35 35 35 35 35 35 35 35 35 35 35
				35 35 35>;

			PS_Config_Lmt_FW_Diff_N = <
				(-35) (-35) (-35) (-35)  (-65535) (-65535) (-65535) (-65535) (-65535) (-65535) (-65535) (-65535) (-65535) (-65535) (-35) (-35) (-35) (-35)
				(-35) (-35) (-35) (-35) (-35) (-35) (-35) (-35) (-35) (-35) (-35) (-35) (-35) (-35) (-35) (-35) (-35) (-35)
				(-35) (-35) (-35) (-35) (-35) (-35) (-35) (-35) (-35) (-35) (-35) (-35) (-35) (-35) (-35) (-35) (-35) (-35)
				(-35) (-35) (-35) (-35) (-35) (-35) (-35) (-35) (-35) (-35) (-35) (-35) (-35) (-35) (-35) (-35) (-35) (-35)
				(-35) (-35) (-35) (-35) (-35) (-35) (-35) (-35) (-35) (-35) (-35) (-35) (-35) (-35) (-35) (-35) (-35) (-35)
				(-35) (-35) (-35) (-35) (-35) (-35) (-35) (-35) (-35) (-35) (-35) (-35) (-35) (-35) (-35) (-35) (-35) (-35)
				(-35) (-35) (-35) (-35) (-35) (-35) (-35) (-35) (-35) (-35) (-35) (-35) (-35) (-35) (-35) (-35) (-35) (-35)
				(-35) (-35) (-35) (-35) (-35) (-35) (-35) (-35) (-35) (-35) (-35) (-35) (-35) (-35) (-35) (-35) (-35) (-35)
				(-35) (-35) (-35) (-35) (-35) (-35) (-35) (-35) (-35) (-35) (-35) (-35) (-35) (-35) (-35) (-35) (-35) (-35)
				(-35) (-35) (-35) (-35) (-35) (-35) (-35) (-35) (-35) (-35) (-35) (-35) (-35) (-35) (-35) (-35) (-35) (-35)
				(-35) (-35) (-35) (-35) (-35) (-35) (-35) (-35) (-35) (-35) (-35) (-35) (-35) (-35) (-35) (-35) (-35) (-35)
				(-35) (-35) (-35) (-35) (-35) (-35) (-35) (-35) (-35) (-35) (-35) (-35) (-35) (-35) (-35) (-35) (-35) (-35)
				(-35) (-35) (-35) (-35) (-35) (-35) (-35) (-35) (-35) (-35) (-35) (-35) (-35) (-35) (-35) (-35) (-35) (-35)
				(-35) (-35) (-35) (-35) (-35) (-35) (-35) (-35) (-35) (-35) (-35) (-35) (-35) (-35) (-35) (-35) (-35) (-35)
				(-35) (-35) (-35) (-35) (-35) (-35) (-35) (-35) (-35) (-35) (-35) (-35) (-35) (-35) (-35) (-35) (-35) (-35)
				(-35) (-35) (-35) (-35) (-35) (-35) (-35) (-35) (-35) (-35) (-35) (-35) (-35) (-35) (-35) (-35) (-35) (-35)
				(-35) (-35) (-35) (-35) (-35) (-35) (-35) (-35) (-35) (-35) (-35) (-35) (-35) (-35) (-35) (-35) (-35) (-35)
				(-35) (-35) (-35) (-35) (-35) (-35) (-35) (-35) (-35) (-35) (-35) (-35) (-35) (-35) (-35) (-35) (-35) (-35)
				(-35) (-35) (-35) (-35) (-35) (-35) (-35) (-35) (-35) (-35) (-35) (-35) (-35) (-35) (-35) (-35) (-35) (-35)
				(-35) (-35) (-35) (-35) (-35) (-35) (-35) (-35) (-35) (-35) (-35) (-35) (-35) (-35) (-35) (-35) (-35) (-35)
				(-35) (-35) (-35) (-35) (-35) (-35) (-35) (-35) (-35) (-35) (-35) (-35) (-35) (-35) (-35) (-35) (-35) (-35)
				(-35) (-35) (-35) (-35) (-35) (-35) (-35) (-35) (-35) (-35) (-35) (-35) (-35) (-35) (-35) (-35) (-35) (-35)
				(-35) (-35) (-35) (-35) (-35) (-35) (-35) (-35) (-35) (-35) (-35) (-35) (-35) (-35) (-35) (-35) (-35) (-35)
				(-35) (-35) (-35) (-35) (-35) (-35) (-35) (-35) (-35) (-35) (-35) (-35) (-35) (-35) (-35) (-35) (-35) (-35)
				(-35) (-35) (-35) (-35) (-35) (-35) (-35) (-35) (-35) (-35) (-35) (-35) (-35) (-35) (-35) (-35) (-35) (-35)
				(-35) (-35) (-35) (-35) (-35) (-35) (-35) (-35) (-35) (-35) (-35) (-35) (-35) (-35) (-35) (-35) (-35) (-35)
				(-35) (-35) (-35) (-35) (-35) (-35) (-35) (-35) (-35) (-35) (-35) (-35) (-35) (-35) (-35) (-35) (-35) (-35)
				(-35) (-35) (-35) (-35) (-35) (-35) (-35) (-35) (-35) (-35) (-35) (-35) (-35) (-35) (-35) (-35) (-35) (-35)
				(-35) (-35) (-35) (-35) (-35) (-35) (-35) (-35) (-35) (-35) (-35) (-35) (-35) (-35) (-35) (-35) (-35) (-35)
				(-35) (-35) (-35) (-35) (-35) (-35) (-35) (-35) (-35) (-35) (-35) (-35) (-35) (-35) (-35) (-35) (-35) (-35)
				(-35) (-35) (-35) (-35) (-35) (-35) (-35) (-35) (-35) (-35) (-35) (-35) (-35) (-35) (-35) (-35) (-35) (-35)
				(-35) (-35) (-35) (-35) (-35) (-35) (-35) (-35) (-35) (-35) (-35) (-35) (-35) (-35) (-35) (-35) (-35) (-35)
				(-35) (-35) (-35)>;

			PS_Config_Diff_Test_Frame = <50>;
		};

		novatek-mp-criteria-5106@0 {
			#address-cells = <1>;
			#size-cells = <0>;
			compatible = "novatek-mp-criteria-5106";//5106 is pid of Truly586	;5105 is pid of TM586

			/* MP Config */
			IC_X_CFG_SIZE = <18>;
			IC_Y_CFG_SIZE = <32>;
			IC_KEY_CFG_SIZE = <4>;
			X_Channel = <18>;
			Y_Channel = <32>;
			AIN_X = <0 1 2 3 4 5 6 7 8 9 10 11 12 13 14 15 16 17>;
			AIN_Y = <0 1 2 3 4 5 6 7 8 9 10 11 12 13 14 15 16 17 18 19 20 21 22 23 24 25 26 27 28 29 30 31>;
			AIN_KEY = <0 1 2 0xFF>;

			/* MP Criteria */
			PS_Config_Lmt_Short_Rawdata_P = <
				14008 14008 14008 14008 14008 14008 14008 14008 14008 14008 14008 14008 14008 14008 14008 14008 14008 14008
				14008 14008 14008 14008 14008 14008 14008 14008 14008 14008 14008 14008 14008 14008 14008 14008 14008 14008
				14008 14008 14008 14008 14008 14008 14008 14008 14008 14008 14008 14008 14008 14008 14008 14008 14008 14008
				14008 14008 14008 14008 14008 14008 14008 14008 14008 14008 14008 14008 14008 14008 14008 14008 14008 14008
				14008 14008 14008 14008 14008 14008 14008 14008 14008 14008 14008 14008 14008 14008 14008 14008 14008 14008
				14008 14008 14008 14008 14008 14008 14008 14008 14008 14008 14008 14008 14008 14008 14008 14008 14008 14008
				14008 14008 14008 14008 14008 14008 14008 14008 14008 14008 14008 14008 14008 14008 14008 14008 14008 14008
				14008 14008 14008 14008 14008 14008 14008 14008 14008 14008 14008 14008 14008 14008 14008 14008 14008 14008
				14008 14008 14008 14008 14008 14008 14008 14008 14008 14008 14008 14008 14008 14008 14008 14008 14008 14008
				14008 14008 14008 14008 14008 14008 14008 14008 14008 14008 14008 14008 14008 14008 14008 14008 14008 14008
				14008 14008 14008 14008 14008 14008 14008 14008 14008 14008 14008 14008 14008 14008 14008 14008 14008 14008
				14008 14008 14008 14008 14008 14008 14008 14008 14008 14008 14008 14008 14008 14008 14008 14008 14008 14008
				14008 14008 14008 14008 14008 14008 14008 14008 14008 14008 14008 14008 14008 14008 14008 14008 14008 14008
				14008 14008 14008 14008 14008 14008 14008 14008 14008 14008 14008 14008 14008 14008 14008 14008 14008 14008
				14008 14008 14008 14008 14008 14008 14008 14008 14008 14008 14008 14008 14008 14008 14008 14008 14008 14008
				14008 14008 14008 14008 14008 14008 14008 14008 14008 14008 14008 14008 14008 14008 14008 14008 14008 14008
				14008 14008 14008 14008 14008 14008 14008 14008 14008 14008 14008 14008 14008 14008 14008 14008 14008 14008
				14008 14008 14008 14008 14008 14008 14008 14008 14008 14008 14008 14008 14008 14008 14008 14008 14008 14008
				14008 14008 14008 14008 14008 14008 14008 14008 14008 14008 14008 14008 14008 14008 14008 14008 14008 14008
				14008 14008 14008 14008 14008 14008 14008 14008 14008 14008 14008 14008 14008 14008 14008 14008 14008 14008
				14008 14008 14008 14008 14008 14008 14008 14008 14008 14008 14008 14008 14008 14008 14008 14008 14008 14008
				14008 14008 14008 14008 14008 14008 14008 14008 14008 14008 14008 14008 14008 14008 14008 14008 14008 14008
				14008 14008 14008 14008 14008 14008 14008 14008 14008 14008 14008 14008 14008 14008 14008 14008 14008 14008
				14008 14008 14008 14008 14008 14008 14008 14008 14008 14008 14008 14008 14008 14008 14008 14008 14008 14008
				14008 14008 14008 14008 14008 14008 14008 14008 14008 14008 14008 14008 14008 14008 14008 14008 14008 14008
				14008 14008 14008 14008 14008 14008 14008 14008 14008 14008 14008 14008 14008 14008 14008 14008 14008 14008
				14008 14008 14008 14008 14008 14008 14008 14008 14008 14008 14008 14008 14008 14008 14008 14008 14008 14008
				14008 14008 14008 14008 14008 14008 14008 14008 14008 14008 14008 14008 14008 14008 14008 14008 14008 14008
				14008 14008 14008 14008 14008 14008 14008 14008 14008 14008 14008 14008 14008 14008 14008 14008 14008 14008
				14008 14008 14008 14008 14008 14008 14008 14008 14008 14008 14008 14008 14008 14008 14008 14008 14008 14008
				14008 14008 14008 14008 14008 14008 14008 14008 14008 14008 14008 14008 14008 14008 14008 14008 14008 14008
				14008 14008 14008 14008 14008 14008 14008 14008 14008 14008 14008 14008 14008 14008 14008 14008 14008 14008
				>;

			PS_Config_Lmt_Short_Rawdata_N = <
				11376 11376 11376 11376 11376 11376 11376 11376 11376 11376 11376 11376 11376 11376 11376 11376 11376 11376
				11376 11376 11376 11376 11376 11376 11376 11376 11376 11376 11376 11376 11376 11376 11376 11376 11376 11376
				11376 11376 11376 11376 11376 11376 11376 11376 11376 11376 11376 11376 11376 11376 11376 11376 11376 11376
				11376 11376 11376 11376 11376 11376 11376 11376 11376 11376 11376 11376 11376 11376 11376 11376 11376 11376
				11376 11376 11376 11376 11376 11376 11376 11376 11376 11376 11376 11376 11376 11376 11376 11376 11376 11376
				11376 11376 11376 11376 11376 11376 11376 11376 11376 11376 11376 11376 11376 11376 11376 11376 11376 11376
				11376 11376 11376 11376 11376 11376 11376 11376 11376 11376 11376 11376 11376 11376 11376 11376 11376 11376
				11376 11376 11376 11376 11376 11376 11376 11376 11376 11376 11376 11376 11376 11376 11376 11376 11376 11376
				11376 11376 11376 11376 11376 11376 11376 11376 11376 11376 11376 11376 11376 11376 11376 11376 11376 11376
				11376 11376 11376 11376 11376 11376 11376 11376 11376 11376 11376 11376 11376 11376 11376 11376 11376 11376
				11376 11376 11376 11376 11376 11376 11376 11376 11376 11376 11376 11376 11376 11376 11376 11376 11376 11376
				11376 11376 11376 11376 11376 11376 11376 11376 11376 11376 11376 11376 11376 11376 11376 11376 11376 11376
				11376 11376 11376 11376 11376 11376 11376 11376 11376 11376 11376 11376 11376 11376 11376 11376 11376 11376
				11376 11376 11376 11376 11376 11376 11376 11376 11376 11376 11376 11376 11376 11376 11376 11376 11376 11376
				11376 11376 11376 11376 11376 11376 11376 11376 11376 11376 11376 11376 11376 11376 11376 11376 11376 11376
				11376 11376 11376 11376 11376 11376 11376 11376 11376 11376 11376 11376 11376 11376 11376 11376 11376 11376
				11376 11376 11376 11376 11376 11376 11376 11376 11376 11376 11376 11376 11376 11376 11376 11376 11376 11376
				11376 11376 11376 11376 11376 11376 11376 11376 11376 11376 11376 11376 11376 11376 11376 11376 11376 11376
				11376 11376 11376 11376 11376 11376 11376 11376 11376 11376 11376 11376 11376 11376 11376 11376 11376 11376
				11376 11376 11376 11376 11376 11376 11376 11376 11376 11376 11376 11376 11376 11376 11376 11376 11376 11376
				11376 11376 11376 11376 11376 11376 11376 11376 11376 11376 11376 11376 11376 11376 11376 11376 11376 11376
				11376 11376 11376 11376 11376 11376 11376 11376 11376 11376 11376 11376 11376 11376 11376 11376 11376 11376
				11376 11376 11376 11376 11376 11376 11376 11376 11376 11376 11376 11376 11376 11376 11376 11376 11376 11376
				11376 11376 11376 11376 11376 11376 11376 11376 11376 11376 11376 11376 11376 11376 11376 11376 11376 11376
				11376 11376 11376 11376 11376 11376 11376 11376 11376 11376 11376 11376 11376 11376 11376 11376 11376 11376
				11376 11376 11376 11376 11376 11376 11376 11376 11376 11376 11376 11376 11376 11376 11376 11376 11376 11376
				11376 11376 11376 11376 11376 11376 11376 11376 11376 11376 11376 11376 11376 11376 11376 11376 11376 11376
				11376 11376 11376 11376 11376 11376 11376 11376 11376 11376 11376 11376 11376 11376 11376 11376 11376 11376
				11376 11376 11376 11376 11376 11376 11376 11376 11376 11376 11376 11376 11376 11376 11376 11376 11376 11376
				11376 11376 11376 11376 11376 11376 11376 11376 11376 11376 11376 11376 11376 11376 11376 11376 11376 11376
				11376 11376 11376 11376 11376 11376 11376 11376 11376 11376 11376 11376 11376 11376 11376 11376 11376 11376
				11376 11376 11376 11376 11376 11376 11376 11376 11376 11376 11376 11376 11376 11376 11376 11376 11376 11376
				>;


			PS_Config_Lmt_Open_Rawdata_P = <
				2938	2941	2975	2941	65535	65535	65535	65535	65535	65535	65535	65535	65535	65535	2885	2935	2916	2919
				1891	2097	2121	2116	2109	1790	1782	1782	1780	1762	1771	1771	1780	2098	2112	2122	2108	1905
				1824	1999	2016	2016	2017	2002	2002	2003	2000	1971	1982	1982	1986	2003	2007	2011	2000	1827
				1779	1989	2007	2006	2000	1958	1957	1961	1962	1954	1954	2023	1960	2003	2097	2006	1989	1801
				1751	1978	1995	2011	1988	1946	1943	1948	1950	1941	2013	1940	1948	2087	2016	1996	2069	1758
				1758	2004	2004	2021	2024	1957	1953	1957	1960	2014	1946	1946	2020	2018	2018	2091	2003	1762
				1741	1983	2004	2002	2003	1937	1934	1937	1939	1941	1940	1940	1946	2014	2014	2018	1999	1754
				1758	1997	2017	2016	2016	1948	1946	1950	1950	1943	1943	1941	1947	2016	2018	2021	2003	1762
				1633	1829	1846	1846	1846	1806	1806	1808	1807	1800	1803	1803	1804	1848	1850	1850	1836	1640
				1639	1835	1852	1852	1850	1811	1813	1815	1814	1810	1811	1810	1813	1853	1857	1859	1842	1647
				1645	1842	1860	1855	1855	1818	1818	1821	1820	1803	1804	1806	1808	1841	1834	1853	1839	1646
				1645	1836	1859	1836	1845	1818	1818	1820	1818	1808	1810	1810	1813	1843	1836	1859	1824	1650
				1647	1817	1850	1834	1839	1814	1814	1817	1817	1801	1803	1801	1804	1832	1829	1832	1817	1646
				1652	1825	1842	1841	1848	1824	1825	1827	1827	1814	1814	1814	1815	1842	1841	1841	1827	1653
				1653	1824	1839	1839	1845	1822	1824	1825	1824	1810	1813	1810	1813	1838	1838	1839	1827	1653
				1654	1827	1842	1841	1845	1824	1825	1827	1827	1814	1815	1815	1818	1842	1843	1846	1832	1659
				1657	1829	1848	1845	1846	1824	1825	1828	1828	1818	1820	1820	1822	1845	1848	1850	1835	1659
				1653	1825	1839	1838	1839	1818	1821	1822	1821	1817	1820	1820	1821	1842	1846	1850	1836	1660
				1663	1836	1852	1849	1849	1831	1832	1834	1832	1817	1820	1821	1822	1843	1846	1849	1836	1663
				1659	1831	1848	1845	1845	1828	1828	1829	1829	1821	1825	1824	1825	1843	1849	1853	1839	1663
				1660	1831	1848	1845	1845	1829	1828	1829	1829	1820	1822	1822	1824	1845	1850	1855	1843	1668
				1660	1836	1853	1852	1850	1834	1834	1835	1835	1821	1822	1824	1825	1845	1850	1855	1842	1667
				1661	1835	1850	1849	1848	1829	1831	1834	1832	1820	1822	1824	1825	1843	1849	1852	1842	1668
				1663	1836	1852	1850	1849	1831	1834	1835	1834	1824	1825	1827	1828	1848	1855	1859	1848	1673
				1667	1841	1857	1856	1855	1838	1838	1839	1838	1822	1824	1827	1827	1848	1852	1856	1846	1671
				1664	1836	1852	1850	1849	1832	1834	1835	1834	1821	1824	1825	1825	1845	1850	1855	1843	1670
				1668	1842	1857	1855	1855	1838	1839	1841	1839	1827	1829	1831	1832	1853	1859	1863	1852	1677
				1668	1843	1857	1856	1855	1836	1839	1841	1841	1825	1829	1831	1831	1852	1859	1863	1852	1678
				1670	1845	1860	1857	1857	1839	1842	1842	1845	1828	1832	1834	1834	1853	1859	1864	1853	1681
				1695	1871	1888	1887	1884	1869	1871	1873	1873	1866	1871	1873	1873	1894	1899	1904	1892	1719
				1745	1951	1974	1975	1974	1955	1958	1960	1957	1939	1950	1950	1951	1974	1981	1983	1968	1758
				1402	1989	2035	2049	2051	2034	2035	2037	2027	2013	2025	2030	2030	2052	2058	2048	2006	1408
				>;

			PS_Config_Lmt_Open_Rawdata_N = <
				1259	1260	1275	1260	(-65535)	(-65535)	(-65535)	(-65535)	(-65535)	(-65535)	(-65535)	(-65535)	(-65535)	(-65535)	1236	1258	1249	1251
				810	898	909	907	904	767	763	763	763	755	759	759	763	899	905	909	903	816
				781	856	864	864	864	858	858	858	857	844	849	849	851	858	860	862	857	783
				762	852	860	859	857	839	838	840	841	837	837	867	840	858	898	859	852	772
				750	847	855	862	852	834	832	835	835	832	862	831	835	894	864	855	886	753
				753	859	859	866	867	838	837	838	840	863	834	834	865	865	865	896	858	755
				746	850	859	858	858	830	829	830	831	832	831	831	834	863	863	865	856	751
				753	856	864	864	864	835	834	835	835	832	832	832	834	864	865	866	858	755
				700	784	791	791	791	774	774	775	774	771	772	772	773	792	793	793	787	703
				702	786	793	793	793	776	777	778	777	775	776	775	777	794	796	796	789	706
				705	789	797	795	795	779	779	780	780	772	773	774	775	789	786	794	788	705
				705	787	796	787	790	779	779	780	779	775	775	775	777	790	787	796	781	707
				706	778	793	786	788	777	777	778	778	772	772	772	773	785	784	785	778	705
				708	782	789	789	792	781	782	783	783	777	777	777	778	789	789	789	783	708
				708	781	788	788	790	781	781	782	781	775	777	775	777	787	787	788	783	708
				709	783	789	789	790	781	782	783	783	777	778	778	779	789	790	791	785	711
				710	784	792	790	791	781	782	783	783	779	780	780	781	790	792	793	786	711
				708	782	788	787	788	779	780	781	780	778	780	780	780	789	791	793	787	711
				712	787	793	792	792	784	785	786	785	778	780	780	781	790	791	792	787	712
				711	784	792	790	790	783	783	784	784	780	782	781	782	790	792	794	788	712
				711	784	792	790	790	784	783	784	784	780	781	781	781	790	793	795	790	715
				711	787	794	793	793	786	786	786	786	780	781	781	782	790	793	795	789	714
				712	786	793	792	792	784	784	786	785	780	781	781	782	790	792	793	789	715
				712	787	793	793	792	784	786	786	786	781	782	783	783	792	795	796	792	717
				714	789	796	795	795	787	787	788	787	781	781	783	783	792	793	795	791	716
				713	787	793	793	792	785	786	786	786	780	781	782	782	790	793	795	790	715
				715	789	796	795	795	787	788	789	788	783	784	784	785	794	796	798	793	718
				715	790	796	795	795	787	788	789	789	782	784	784	784	793	796	798	793	719
				715	790	797	796	796	788	789	789	790	783	785	786	786	794	796	799	794	720
				726	802	809	808	807	801	802	802	802	799	802	802	802	811	814	816	811	736
				748	836	846	846	846	838	839	840	838	831	835	835	836	846	849	850	843	753
				601	852	872	878	879	871	872	873	868	862	868	870	870	879	882	877	859	603
				>;

			PS_Config_Lmt_FW_Rawdata_P = <
				1682	1656	1673	1671	65535	65535	65535	65535	65535	65535	65535	65535	65535	65535	1674	1681	1687	1709
				1687	1670	1680	1678	1671	1659	1663	1684	1681	1664	1667	1675	1695	1682	1674	1673	1668	1688
				1659	1663	1664	1670	1668	1674	1675	1668	1667	1675	1675	1663	1668	1671	1674	1680	1685	1702
				1664	1668	1682	1677	1670	1670	1668	1681	1667	1668	1675	1675	1678	1677	1671	1673	1685	1678
				1678	1674	1677	1691	1674	1681	1678	1670	1680	1680	1671	1660	1664	1667	1674	1684	1685	1698
				1674	1667	1675	1671	1664	1663	1667	1680	1663	1681	1666	1684	1689	1666	1668	1660	1668	1688
				1680	1685	1685	1680	1673	1675	1670	1668	1659	1678	1680	1666	1663	1680	1677	1682	1664	1694
				1677	1675	1681	1677	1670	1668	1668	1659	1657	1684	1680	1664	1675	1681	1660	1664	1685	1677
				1661	1681	1681	1670	1663	1670	1671	1674	1674	1688	1671	1667	1673	1675	1692	1671	1667	1688
				1657	1663	1666	1670	1667	1664	1666	1678	1664	1684	1670	1671	1667	1681	1663	1681	1680	1695
				1664	1677	1685	1681	1671	1678	1674	1668	1674	1678	1674	1681	1670	1667	1677	1678	1681	1671
				1685	1682	1680	1681	1673	1677	1660	1673	1661	1664	1674	1680	1657	1664	1656	1668	1674	1685
				1660	1670	1666	1671	1680	1667	1670	1668	1673	1674	1668	1664	1664	1678	1677	1667	1660	1689
				1664	1666	1670	1675	1654	1666	1670	1678	1656	1681	1667	1670	1668	1667	1664	1667	1671	1667
				1654	1660	1678	1667	1649	1649	1666	1688	1684	1677	1678	1659	1663	1692	1677	1702	1682	1680
				1659	1674	1688	1685	1673	1666	1660	1670	1663	1692	1666	1661	1685	1680	1677	1678	1666	1681
				1670	1680	1691	1680	1660	1673	1677	1685	1680	1677	1678	1675	1659	1671	1671	1670	1677	1688
				1671	1668	1664	1668	1674	1677	1674	1671	1678	1678	1677	1668	1678	1684	1685	1687	1661	1687
				1653	1656	1670	1660	1674	1670	1660	1674	1687	1674	1667	1677	1682	1659	1670	1667	1675	1689
				1668	1673	1670	1681	1667	1671	1681	1682	1678	1680	1668	1652	1694	1688	1692	1684	1680	1675
				1654	1687	1680	1677	1675	1675	1674	1674	1680	1666	1681	1671	1671	1680	1671	1667	1664	1688
				1677	1675	1680	1678	1670	1678	1680	1668	1673	1657	1671	1678	1680	1660	1673	1671	1664	1687
				1667	1661	1661	1664	1654	1657	1668	1692	1674	1682	1671	1650	1689	1691	1684	1688	1684	1681
				1664	1670	1661	1666	1685	1677	1664	1671	1664	1670	1684	1675	1663	1670	1677	1667	1671	1677
				1674	1681	1685	1688	1677	1682	1684	1664	1687	1671	1674	1678	1688	1675	1680	1670	1680	1681
				1663	1680	1682	1675	1675	1681	1682	1673	1659	1659	1680	1689	1671	1660	1668	1661	1668	1692
				1678	1680	1680	1678	1670	1677	1680	1670	1671	1656	1675	1680	1671	1667	1666	1670	1680	1688
				1668	1671	1671	1659	1687	1673	1666	1656	1681	1671	1681	1668	1668	1685	1663	1659	1660	1703
				1670	1681	1689	1692	1668	1678	1684	1689	1673	1670	1675	1668	1668	1687	1663	1659	1671	1696
				1670	1661	1673	1667	1671	1678	1680	1678	1667	1692	1680	1675	1677	1675	1668	1673	1684	1691
				1685	1674	1684	1682	1688	1685	1682	1677	1660	1684	1667	1666	1687	1685	1677	1687	1677	1699
				1689	1682	1681	1666	1660	1681	1698	1696	1674	1668	1678	1675	1680	1674	1677	1666	1670	1684
				>;

			PS_Config_Lmt_FW_Rawdata_N = <
				721	709	717	716	(-65535)	(-65535)	(-65535)	(-65535)	(-65535)	(-65535)	(-65535)	(-65535)	(-65535)	(-65535)	717	720	723	732
				723	715	720	719	716	711	712	721	720	713	714	718	726	721	717	717	715	723
				711	712	713	715	715	717	718	715	714	718	718	712	715	716	717	720	722	729
				713	715	721	718	715	715	715	720	714	715	718	718	719	718	716	717	722	719
				719	717	718	724	717	720	719	715	720	720	716	711	713	714	717	721	722	727
				717	714	718	716	713	712	714	720	712	720	714	721	724	714	715	711	715	723
				720	722	722	720	717	718	715	715	711	719	720	714	712	720	718	721	713	726
				718	718	720	718	715	715	715	711	710	721	720	713	718	720	711	713	722	718
				712	720	720	715	712	715	716	717	717	723	716	714	717	718	725	716	714	723
				710	712	714	715	714	713	714	719	713	721	715	716	714	720	712	720	720	726
				713	718	722	720	716	719	717	715	717	719	717	720	715	714	718	719	720	716
				722	721	720	720	717	718	711	717	712	713	717	720	710	713	709	715	717	722
				711	715	714	716	720	714	715	715	717	717	715	713	713	719	718	714	711	724
				713	714	715	718	709	714	715	719	709	720	714	715	715	714	713	714	716	714
				709	711	719	714	706	706	714	723	721	718	719	711	712	725	718	729	721	720
				711	717	723	722	717	714	711	715	712	725	714	712	722	720	718	719	714	720
				715	720	724	720	711	717	718	722	720	718	719	718	711	716	716	715	718	723
				716	715	713	715	717	718	717	716	719	719	718	715	719	721	722	723	712	723
				708	709	715	711	717	715	711	717	723	717	714	718	721	711	715	714	718	724
				715	717	715	720	714	716	720	721	719	720	715	708	726	723	725	721	720	718
				709	723	720	718	718	718	717	717	720	714	720	716	716	720	716	714	713	723
				718	718	720	719	715	719	720	715	717	710	716	719	720	711	717	716	713	723
				714	712	712	713	709	710	715	725	717	721	716	707	724	724	721	723	721	720
				713	715	712	714	722	718	713	716	713	715	721	718	712	715	718	714	716	718
				717	720	722	723	718	721	721	713	723	716	717	719	723	718	720	715	720	720
				712	720	721	718	718	720	721	717	711	711	720	724	716	711	715	712	715	725
				719	720	720	719	715	718	720	715	716	709	718	720	716	714	714	715	720	723
				715	716	716	711	723	717	714	709	720	716	720	715	715	722	712	711	711	730
				715	720	724	725	715	719	721	724	717	715	718	715	715	723	712	711	716	727
				715	712	717	714	716	719	720	719	714	725	720	718	718	718	715	717	721	724
				722	717	721	721	723	722	721	718	711	721	714	714	723	722	718	723	718	728
				724	721	720	714	711	720	727	727	717	715	719	718	720	717	718	714	715	721

				>;

			PS_Config_Lmt_FW_CC_P = <
				164	143	143	144	65535	65535	65535	65535	65535	65535	65535	65535	65535	65535	149	147	147	168
				146	143	143	143	143	140	140	142	143	147	144	144	143	147	147	147	147	151
				144	142	142	142	143	143	143	143	146	149	144	144	144	144	143	144	144	147
				146	143	142	142	143	143	143	143	146	149	144	144	144	144	143	143	142	146
				146	143	143	143	143	143	144	144	146	149	146	146	146	146	143	143	143	147
				144	142	142	142	143	143	143	143	146	150	146	146	146	144	143	143	143	146
				146	142	142	142	143	143	143	144	147	150	147	147	146	146	144	144	144	147
				146	143	143	143	144	144	144	144	147	150	147	146	146	146	144	144	144	147
				143	140	140	140	142	142	142	142	144	146	143	143	143	142	140	140	140	143
				142	140	140	140	140	140	142	142	144	147	144	144	143	143	142	142	142	144
				143	140	140	140	140	142	142	142	144	147	144	143	143	143	142	142	142	144
				143	140	140	140	142	142	142	142	144	147	143	143	143	143	142	140	140	143
				143	140	140	140	142	142	142	142	144	146	143	143	143	142	142	140	140	143
				143	140	140	140	140	142	142	142	144	147	144	144	143	143	142	142	142	144
				143	140	140	140	142	142	142	142	144	147	144	144	143	143	142	142	142	144
				143	140	140	140	142	142	142	143	146	147	144	144	144	143	143	142	142	144
				144	142	142	142	143	143	143	143	146	149	146	144	144	144	143	143	143	146
				143	140	142	140	142	142	142	143	146	149	146	146	144	144	143	143	143	146
				144	142	142	142	142	142	143	143	146	149	146	144	144	144	143	143	143	146
				144	142	142	142	143	143	143	143	146	149	146	146	144	144	143	143	143	146
				144	142	142	142	143	143	143	144	146	149	146	144	144	144	143	143	143	146
				144	142	142	142	142	143	143	143	146	150	147	146	146	146	144	144	144	147
				144	142	142	142	143	143	143	143	146	149	146	146	146	144	143	144	143	147
				144	142	142	142	143	143	143	143	146	150	146	146	146	146	144	144	144	147
				144	142	142	142	143	143	143	143	146	149	146	146	144	144	143	143	143	147
				144	140	140	142	142	142	142	143	146	150	146	146	146	146	144	144	144	147
				144	142	142	142	143	143	143	143	146	150	147	146	146	146	144	144	144	147
				144	142	142	142	143	143	143	143	146	150	146	146	146	146	144	144	144	147
				146	142	142	142	143	143	143	144	146	150	146	146	146	146	144	144	144	147
				144	142	142	142	143	143	143	143	146	150	147	147	147	147	146	146	146	149
				146	143	143	143	144	144	144	144	147	151	149	149	147	147	147	147	147	150
				143	151	150	147	147	147	147	149	154	158	151	150	150	150	150	153	154	144
				>;

			PS_Config_Lmt_FW_CC_N = <
				73	64	64	65	(-65535)	(-65535)	(-65535)	(-65535)	(-65535)	(-65535)	(-65535)	(-65535)	(-65535)	(-65535)	66	66	66	75
				65	64	64	64	64	63	63	63	64	66	65	65	64	66	66	66	66	68
				65	63	63	63	64	64	64	64	65	66	65	65	65	65	64	65	65	66
				65	64	63	63	64	64	64	64	65	66	65	65	65	65	64	64	63	65
				65	64	64	64	64	64	65	65	65	66	65	65	65	65	64	64	64	66
				65	63	63	63	64	64	64	64	65	67	65	65	65	65	64	64	64	65
				65	63	63	63	64	64	64	65	66	67	66	66	65	65	65	65	65	66
				65	64	64	64	65	65	65	65	66	67	66	65	65	65	65	65	65	66
				64	63	63	63	63	63	63	63	65	65	64	64	64	63	63	63	63	64
				63	63	63	63	63	63	63	63	65	66	65	65	64	64	63	63	63	65
				64	63	63	63	63	63	63	63	65	66	65	64	64	64	63	63	63	65
				64	63	63	63	63	63	63	63	65	66	64	64	64	64	63	63	63	64
				64	63	63	63	63	63	63	63	65	65	64	64	64	63	63	63	63	64
				64	63	63	63	63	63	63	63	65	66	65	65	64	64	63	63	63	65
				64	63	63	63	63	63	63	63	65	66	65	65	64	64	63	63	63	65
				64	63	63	63	63	63	63	64	65	66	65	65	65	64	64	63	63	65
				65	63	63	63	64	64	64	64	65	66	65	65	65	65	64	64	64	65
				64	63	63	63	63	63	63	64	65	66	65	65	65	65	64	64	64	65
				65	63	63	63	63	63	64	64	65	66	65	65	65	65	64	64	64	65
				65	63	63	63	64	64	64	64	65	66	65	65	65	65	64	64	64	65
				65	63	63	63	64	64	64	65	65	66	65	65	65	65	64	64	64	65
				65	63	63	63	63	64	64	64	65	67	66	65	65	65	65	65	65	66
				65	63	63	63	64	64	64	64	65	66	65	65	65	65	64	65	64	66
				65	63	63	63	64	64	64	64	65	67	65	65	65	65	65	65	65	66
				65	63	63	63	64	64	64	64	65	66	65	65	65	65	64	64	64	66
				65	63	63	63	63	63	63	64	65	67	65	65	65	65	65	65	65	66
				65	63	63	63	64	64	64	64	65	67	66	65	65	65	65	65	65	66
				65	63	63	63	64	64	64	64	65	67	65	65	65	65	65	65	65	66
				65	63	63	63	64	64	64	65	65	67	65	65	65	65	65	65	65	66
				65	63	63	63	64	64	64	64	65	67	66	66	66	66	65	65	65	66
				65	64	64	64	65	65	65	65	66	68	66	66	66	66	66	66	66	67
				64	68	67	66	66	66	66	66	69	71	68	67	67	67	67	68	69	65
				>;

			PS_Config_Lmt_FW_Diff_P = <
					50	50	50	50	65535	65535	65535	65535	65535	65535	65535	65535	65535	65535	50	50	50	50
					50	50	50	50	50	50	50	50	50	50	50	50	50	50	50	50	50	50
					50	50	50	50	50	50	50	50	50	50	50	50	50	50	50	50	50	50
					50	50	50	50	50	50	50	50	50	50	50	50	50	50	50	50	50	50
					50	50	50	50	50	50	50	50	50	50	50	50	50	50	50	50	50	50
					50	50	50	50	50	50	50	50	50	50	50	50	50	50	50	50	50	50
					50	50	50	50	50	50	50	50	50	50	50	50	50	50	50	50	50	50
					50	50	50	50	50	50	50	50	50	50	50	50	50	50	50	50	50	50
					50	50	50	50	50	50	50	50	50	50	50	50	50	50	50	50	50	50
					50	50	50	50	50	50	50	50	50	50	50	50	50	50	50	50	50	50
					50	50	50	50	50	50	50	50	50	50	50	50	50	50	50	50	50	50
					50	50	50	50	50	50	50	50	50	50	50	50	50	50	50	50	50	50
					50	50	50	50	50	50	50	50	50	50	50	50	50	50	50	50	50	50
					50	50	50	50	50	50	50	50	50	50	50	50	50	50	50	50	50	50
					50	50	50	50	50	50	50	50	50	50	50	50	50	50	50	50	50	50
					50	50	50	50	50	50	50	50	50	50	50	50	50	50	50	50	50	50
					50	50	50	50	50	50	50	50	50	50	50	50	50	50	50	50	50	50
					50	50	50	50	50	50	50	50	50	50	50	50	50	50	50	50	50	50
					50	50	50	50	50	50	50	50	50	50	50	50	50	50	50	50	50	50
					50	50	50	50	50	50	50	50	50	50	50	50	50	50	50	50	50	50
					50	50	50	50	50	50	50	50	50	50	50	50	50	50	50	50	50	50
					50	50	50	50	50	50	50	50	50	50	50	50	50	50	50	50	50	50
					50	50	50	50	50	50	50	50	50	50	50	50	50	50	50	50	50	50
					50	50	50	50	50	50	50	50	50	50	50	50	50	50	50	50	50	50
					50	50	50	50	50	50	50	50	50	50	50	50	50	50	50	50	50	50
					50	50	50	50	50	50	50	50	50	50	50	50	50	50	50	50	50	50
					50	50	50	50	50	50	50	50	50	50	50	50	50	50	50	50	50	50
					50	50	50	50	50	50	50	50	50	50	50	50	50	50	50	50	50	50
					50	50	50	50	50	50	50	50	50	50	50	50	50	50	50	50	50	50
					50	50	50	50	50	50	50	50	50	50	50	50	50	50	50	50	50	50
					50	50	50	50	50	50	50	50	50	50	50	50	50	50	50	50	50	50
					50	50	50	50	50	50	50	50	50	50	50	50	50	50	50	50	50	50
				35 35 35>;

			PS_Config_Lmt_FW_Diff_N = <
				(-50) (-50) (-50) (-50)  (-65535) (-65535) (-65535) (-65535) (-65535) (-65535) (-65535) (-65535) (-65535) (-65535) (-50) (-50) (-50) (-50)
				(-50) (-50) (-50) (-50) (-50) (-50) (-50) (-50) (-50) (-50) (-50) (-50) (-50) (-50) (-50) (-50) (-50) (-50)
				(-50) (-50) (-50) (-50) (-50) (-50) (-50) (-50) (-50) (-50) (-50) (-50) (-50) (-50) (-50) (-50) (-50) (-50)
				(-50) (-50) (-50) (-50) (-50) (-50) (-50) (-50) (-50) (-50) (-50) (-50) (-50) (-50) (-50) (-50) (-50) (-50)
				(-50) (-50) (-50) (-50) (-50) (-50) (-50) (-50) (-50) (-50) (-50) (-50) (-50) (-50) (-50) (-50) (-50) (-50)
				(-50) (-50) (-50) (-50) (-50) (-50) (-50) (-50) (-50) (-50) (-50) (-50) (-50) (-50) (-50) (-50) (-50) (-50)
				(-50) (-50) (-50) (-50) (-50) (-50) (-50) (-50) (-50) (-50) (-50) (-50) (-50) (-50) (-50) (-50) (-50) (-50)
				(-50) (-50) (-50) (-50) (-50) (-50) (-50) (-50) (-50) (-50) (-50) (-50) (-50) (-50) (-50) (-50) (-50) (-50)
				(-50) (-50) (-50) (-50) (-50) (-50) (-50) (-50) (-50) (-50) (-50) (-50) (-50) (-50) (-50) (-50) (-50) (-50)
				(-50) (-50) (-50) (-50) (-50) (-50) (-50) (-50) (-50) (-50) (-50) (-50) (-50) (-50) (-50) (-50) (-50) (-50)
				(-50) (-50) (-50) (-50) (-50) (-50) (-50) (-50) (-50) (-50) (-50) (-50) (-50) (-50) (-50) (-50) (-50) (-50)
				(-50) (-50) (-50) (-50) (-50) (-50) (-50) (-50) (-50) (-50) (-50) (-50) (-50) (-50) (-50) (-50) (-50) (-50)
				(-50) (-50) (-50) (-50) (-50) (-50) (-50) (-50) (-50) (-50) (-50) (-50) (-50) (-50) (-50) (-50) (-50) (-50)
				(-50) (-50) (-50) (-50) (-50) (-50) (-50) (-50) (-50) (-50) (-50) (-50) (-50) (-50) (-50) (-50) (-50) (-50)
				(-50) (-50) (-50) (-50) (-50) (-50) (-50) (-50) (-50) (-50) (-50) (-50) (-50) (-50) (-50) (-50) (-50) (-50)
				(-50) (-50) (-50) (-50) (-50) (-50) (-50) (-50) (-50) (-50) (-50) (-50) (-50) (-50) (-50) (-50) (-50) (-50)
				(-50) (-50) (-50) (-50) (-50) (-50) (-50) (-50) (-50) (-50) (-50) (-50) (-50) (-50) (-50) (-50) (-50) (-50)
				(-50) (-50) (-50) (-50) (-50) (-50) (-50) (-50) (-50) (-50) (-50) (-50) (-50) (-50) (-50) (-50) (-50) (-50)
				(-50) (-50) (-50) (-50) (-50) (-50) (-50) (-50) (-50) (-50) (-50) (-50) (-50) (-50) (-50) (-50) (-50) (-50)
				(-50) (-50) (-50) (-50) (-50) (-50) (-50) (-50) (-50) (-50) (-50) (-50) (-50) (-50) (-50) (-50) (-50) (-50)
				(-50) (-50) (-50) (-50) (-50) (-50) (-50) (-50) (-50) (-50) (-50) (-50) (-50) (-50) (-50) (-50) (-50) (-50)
				(-50) (-50) (-50) (-50) (-50) (-50) (-50) (-50) (-50) (-50) (-50) (-50) (-50) (-50) (-50) (-50) (-50) (-50)
				(-50) (-50) (-50) (-50) (-50) (-50) (-50) (-50) (-50) (-50) (-50) (-50) (-50) (-50) (-50) (-50) (-50) (-50)
				(-50) (-50) (-50) (-50) (-50) (-50) (-50) (-50) (-50) (-50) (-50) (-50) (-50) (-50) (-50) (-50) (-50) (-50)
				(-50) (-50) (-50) (-50) (-50) (-50) (-50) (-50) (-50) (-50) (-50) (-50) (-50) (-50) (-50) (-50) (-50) (-50)
				(-50) (-50) (-50) (-50) (-50) (-50) (-50) (-50) (-50) (-50) (-50) (-50) (-50) (-50) (-50) (-50) (-50) (-50)
				(-50) (-50) (-50) (-50) (-50) (-50) (-50) (-50) (-50) (-50) (-50) (-50) (-50) (-50) (-50) (-50) (-50) (-50)
				(-50) (-50) (-50) (-50) (-50) (-50) (-50) (-50) (-50) (-50) (-50) (-50) (-50) (-50) (-50) (-50) (-50) (-50)
				(-50) (-50) (-50) (-50) (-50) (-50) (-50) (-50) (-50) (-50) (-50) (-50) (-50) (-50) (-50) (-50) (-50) (-50)
				(-50) (-50) (-50) (-50) (-50) (-50) (-50) (-50) (-50) (-50) (-50) (-50) (-50) (-50) (-50) (-50) (-50) (-50)
				(-50) (-50) (-50) (-50) (-50) (-50) (-50) (-50) (-50) (-50) (-50) (-50) (-50) (-50) (-50) (-50) (-50) (-50)
				(-50) (-50) (-50) (-50) (-50) (-50) (-50) (-50) (-50) (-50) (-50) (-50) (-50) (-50) (-50) (-50) (-50) (-50)
				(-35) (-35) (-35)>;

			PS_Config_Diff_Test_Frame = <50>;
		};
	};
};
